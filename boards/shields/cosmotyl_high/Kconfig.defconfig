## boards/shields/cosmotyl_high/Kconfig.defconfig
```kconfig
if SHIELD_COSMOTYL_HIGH_LEFT

config ZMK_KEYBOARD_NAME
    default "cosmotyl-high"

config ZMK_SPLIT_ROLE_CENTRAL
    default y

endif # SHIELD_COSMOTYL_HIGH_LEFT

if SHIELD_COSMOTYL_HIGH_LEFT || SHIELD_COSMOTYL_HIGH_RIGHT

config ZMK_SPLIT
    default y

endif # SHIELD_COSMOTYL_HIGH_LEFT || SHIELD_COSMOTYL_HIGH_RIGHT
```

## boards/shields/cosmotyl_high/Kconfig.shield
```kconfig
config SHIELD_COSMOTYL_HIGH_LEFT
    def_bool $(shields_list_contains,cosmotyl_high_left)

config SHIELD_COSMOTYL_HIGH_RIGHT
    def_bool $(shields_list_contains,cosmotyl_high_right)
```
